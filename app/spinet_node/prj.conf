## CMakeLists.txt
```
cmake_minimum_required(VERSION 3.20.0)

find_package(Zephyr REQUIRED HINTS $ENV{ZEPHYR_BASE})
project(spinet_node)

target_sources(app PRIVATE src/main.c)
target_include_directories(app PRIVATE
  ${CMAKE_CURRENT_SOURCE_DIR}/../../../modules/net_echo
  ${CMAKE_CURRENT_SOURCE_DIR}/../../../modules/config
  ${CMAKE_CURRENT_SOURCE_DIR}/../../../modules/messenger
  ${CMAKE_CURRENT_SOURCE_DIR}/../../../modules/command
)
add_subdirectory(${CMAKE_CURRENT_SOURCE_DIR}/../../../modules/net_echo ${CMAKE_BINARY_DIR}/net_echo)
add_subdirectory(${CMAKE_CURRENT_SOURCE_DIR}/../../../modules/config ${CMAKE_BINARY_DIR}/config)
add_subdirectory(${CMAKE_CURRENT_SOURCE_DIR}/../../../modules/messenger ${CMAKE_BINARY_DIR}/messenger)
add_subdirectory(${CMAKE_CURRENT_SOURCE_DIR}/../../../modules/command ${CMAKE_BINARY_DIR}/command)
target_link_libraries(app PRIVATE net_echo command)
```

## prj.conf
```kconfig
#
# Zephyr configuration for spinet_node (CC13xx, 6LoWPAN border router)
#

CONFIG_MAIN_STACK_SIZE=4096
CONFIG_SYSTEM_WORKQUEUE_STACK_SIZE=4096

# Kernel and logging
CONFIG_LOG=y
CONFIG_LOG_DEFAULT_LEVEL=3
CONFIG_PRINTK=y

# 6LoWPAN over IEEE 802.15.4 (border router / mesh root)
CONFIG_NETWORKING=y
CONFIG_NET_IPV6=y
CONFIG_NET_6LO=y
CONFIG_NET_SOCKETS=y
CONFIG_NET_UDP=y
CONFIG_NET_L2_IEEE802154=y
CONFIG_NET_L2_IEEE802154_6LOWPAN=y
CONFIG_NET_CONFIG_SETTINGS=y
CONFIG_NET_CONFIG_AUTO_INIT=y
CONFIG_NET_CONFIG_NEED_IPV6=y

CONFIG_NET_PKT_RX_COUNT=16
CONFIG_NET_PKT_TX_COUNT=16
CONFIG_NET_BUF_RX_COUNT=48
CONFIG_NET_BUF_TX_COUNT=48
CONFIG_NET_CONTEXT_NET_PKT_POOL=y
CONFIG_NET_IF_UNICAST_IPV6_ADDR_COUNT=3
CONFIG_NET_IF_MCAST_IPV6_ADDR_COUNT=4
CONFIG_NET_MAX_CONTEXTS=10
CONFIG_NET_IF_MAX_IPV6_COUNT=3
CONFIG_SETTINGS=y
CONFIG_SETTINGS_NVS=y
CONFIG_NVS=y
```

## src/main.c
```c
#include <zephyr/kernel.h>
#include <zephyr/logging/log.h>
#include "echo_z.h"
#include "config_z.h"
#include "messenger_z.h"
#include "command_z.h"

LOG_MODULE_REGISTER(spinet_node, LOG_LEVEL_INF);

#define SPINET_DEVTYPE 0x222
#define ECHO_SERVER_STACK_SIZE 1024
#define ECHO_SERVER_PRIORITY   5
K_THREAD_STACK_DEFINE(echo_server_stack, ECHO_SERVER_STACK_SIZE);
static struct k_thread echo_server_thread;

static void echo_server_entry(void *p1, void *p2, void *p3)
{
	ARG_UNUSED(p1);
	ARG_UNUSED(p2);
	ARG_UNUSED(p3);
	net_echo_server_run(NET_ECHO_PORT);
}

/*
 * Zephyr spinet (edge) node: UDP echo server and command handler.
 * Border-router and SPI/UART bridge can be added later.
 */
void main(void)
{
	LOG_INF("spinet_node: Zephyr app starting");

	config_z_init(SPINET_DEVTYPE);
	messenger_z_init();
	command_z_register();

	k_thread_create(&echo_server_thread, echo_server_stack,
			K_THREAD_STACK_SIZEOF(echo_server_stack),
			echo_server_entry, NULL, NULL, NULL,
			ECHO_SERVER_PRIORITY, 0, K_NO_WAIT);

	while (1) {
		k_sleep(K_SECONDS(10));
	}
}
```
