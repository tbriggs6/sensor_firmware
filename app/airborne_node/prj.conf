## CMakeLists.txt
```
cmake_minimum_required(VERSION 3.20.0)

find_package(Zephyr REQUIRED HINTS $ENV{ZEPHYR_BASE})
project(airborne_node)

target_sources(app PRIVATE src/main.c)
target_include_directories(app PRIVATE
  ${CMAKE_CURRENT_SOURCE_DIR}/../../../modules/net_echo
  ${CMAKE_CURRENT_SOURCE_DIR}/../../../modules/config
  ${CMAKE_CURRENT_SOURCE_DIR}/../../../modules/messenger
  ${CMAKE_CURRENT_SOURCE_DIR}/../../../modules/command
  ${CMAKE_CURRENT_SOURCE_DIR}/../../../modules/sensors
)
add_subdirectory(${CMAKE_CURRENT_SOURCE_DIR}/../../../modules/net_echo ${CMAKE_BINARY_DIR}/net_echo)
add_subdirectory(${CMAKE_CURRENT_SOURCE_DIR}/../../../modules/config ${CMAKE_BINARY_DIR}/config)
add_subdirectory(${CMAKE_CURRENT_SOURCE_DIR}/../../../modules/messenger ${CMAKE_BINARY_DIR}/messenger)
add_subdirectory(${CMAKE_CURRENT_SOURCE_DIR}/../../../modules/command ${CMAKE_BINARY_DIR}/command)
add_subdirectory(${CMAKE_CURRENT_SOURCE_DIR}/../../../modules/sensors ${CMAKE_BINARY_DIR}/sensors)
target_link_libraries(app PRIVATE net_echo command sensors)
```

## prj.conf
```kconfig
#
# Zephyr configuration for airborne_node (CC13xx, 6LoWPAN airborne sensor)
#

CONFIG_MAIN_STACK_SIZE=2048
CONFIG_SYSTEM_WORKQUEUE_STACK_SIZE=2048

# Kernel and logging
CONFIG_LOG=y
CONFIG_LOG_DEFAULT_LEVEL=3
CONFIG_PRINTK=y

# 6LoWPAN over IEEE 802.15.4
CONFIG_NETWORKING=y
CONFIG_NET_IPV6=y
CONFIG_NET_6LO=y
CONFIG_NET_SOCKETS=y
CONFIG_NET_UDP=y
CONFIG_NET_L2_IEEE802154=y
CONFIG_NET_L2_IEEE802154_6LOWPAN=y
CONFIG_NET_CONFIG_SETTINGS=y
CONFIG_NET_CONFIG_AUTO_INIT=y
CONFIG_NET_CONFIG_NEED_IPV6=y

CONFIG_NET_PKT_RX_COUNT=8
CONFIG_NET_PKT_TX_COUNT=8
CONFIG_NET_BUF_RX_COUNT=32
CONFIG_NET_BUF_TX_COUNT=32
CONFIG_NET_CONTEXT_NET_PKT_POOL=y
CONFIG_NET_IF_UNICAST_IPV6_ADDR_COUNT=2
CONFIG_NET_IF_MCAST_IPV6_ADDR_COUNT=2
CONFIG_NET_MAX_CONTEXTS=6
CONFIG_NET_IF_MAX_IPV6_COUNT=2
CONFIG_SETTINGS=y
CONFIG_SETTINGS_NVS=y
CONFIG_NVS=y
```

## src/main.c
```c
/*
 * Zephyr airborne sensor node: SI7020 humidity/temp, periodic reporting.
 */
#include <zephyr/kernel.h>
#include <zephyr/logging/log.h>
#include <string.h>
#include "echo_z.h"
#include "config_z.h"
#include "messenger_z.h"
#include "command_z.h"
#include "message_z.h"
#include "si7020_z.h"
#include "analog_z.h"

LOG_MODULE_REGISTER(airborne_node, LOG_LEVEL_INF);

#define AIRBORNE_SENSOR_DEVTYPE 0x333
#define PEER_IPV6_DEFAULT "fd00::1"

static uint32_t sequence;
static int failure_counter;

static void send_airborne_data(void)
{
	airborne_t message;
	messenger_addr_t addr;
	config_receiver_t recv;
	si7020_data_t sdata;

	memset(&message, 0, sizeof(message));
	message.header = AIRBORNE_HEADER_Z;
	message.sequence = sequence++;
	message.rssi = messenger_z_recvd_rssi();

	if (si7020_z_sample(&sdata) == 0) {
		message.si7020_humid = sdata.humidity;
		message.si7020_temp = sdata.temperature;
	}
	message.ms5637_pressure = 0;
	message.ms5637_temp = 0;
	message.battery = analog_z_vbat_read();
	message.i2cerror = 0;

	config_z_get_receiver(&recv);
	memcpy(addr.u16, recv.server, sizeof(addr.u16));

	if (messenger_z_send(&addr, MESSAGE_SERVER_PORT_Z, (uint16_t)message.sequence,
			    &message, sizeof(message)) == 0) {
		messenger_z_wait_reply(2000);
		if (messenger_z_last_result_okack()) {
			failure_counter = 0;
		} else {
			failure_counter++;
		}
	} else {
		failure_counter++;
	}
}

static void airborne_work_handler(struct k_work *work);
K_WORK_DELAYABLE_DEFINE(airborne_work, airborne_work_handler);

static void airborne_work_handler(struct k_work *work)
{
	send_airborne_data();
	k_work_reschedule(&airborne_work,
			  failure_counter > 0 ? K_SECONDS(config_z_get_retry_interval())
					      : K_SECONDS(config_z_get_sensor_interval()));
}

void main(void)
{
	LOG_INF("airborne_node: Zephyr app starting");

	sequence = 0;
	failure_counter = 0;

	config_z_init(AIRBORNE_SENSOR_DEVTYPE);
	messenger_z_init();
	command_z_register();
	si7020_z_init(NULL, 0x40);
	analog_z_init(NULL, 0, 0);

	k_sleep(K_SECONDS(5));
	if (net_echo_client_send_once(PEER_IPV6_DEFAULT, NET_ECHO_PORT, NULL, 0, 3000)) {
		LOG_INF("echo OK");
	}

	k_work_reschedule(&airborne_work, K_SECONDS(1));

	while (1) {
		k_sleep(K_SECONDS(60));
	}
}
```
